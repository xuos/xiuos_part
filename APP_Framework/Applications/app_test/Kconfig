## APP_Framework/Applications/app_test/Kconfig
```kconfig
menu "test app"
    menuconfig USER_TEST
        bool "Enable application test function "
        default n

        if USER_TEST
            menuconfig USER_TEST_ADC
                bool "Config test adc"
                default n
                if USER_TEST_ADC
                    if ADD_XIZI_FETURES
                        config ADC_DEV_DRIVER
                            string "Set ADC dev path"
                            default "/dev/adc1_dev"
                    endif
                endif

            menuconfig USER_TEST_DAC
                bool "Config test dac"
                default n
                if USER_TEST_DAC
                    if ADD_XIZI_FETURES
                        config DAC_DEV_DRIVER
                            string "Set DAC dev path"
                            default "/dev/dac_dev"
                    endif
                endif

            menuconfig USER_TEST_FS
                bool "Config test fs with sd or usb"
                default n
                if USER_TEST_FS
                    if ADD_XIZI_FETURES
                        config SD_FPATH
                            string "Set test file path"
                            default "/test_file"
                    endif
                endif


            menuconfig USER_TEST_GPIO
                select BSP_USING_GPIO
                select RESOURCES_PIN
                select BSP_USING_LED
                select BSP_USING_KEY
                bool "Config test gpio with led and key"
                default n
                if USER_TEST_GPIO
                    if ADD_XIZI_FETURES
                        config GPIO_DEV_DRIVER
                            string "Set gpio dev path"
                            default "/dev/pin_dev"
                    endif
                endif

            menuconfig USER_TEST_I2C
                select BSP_USING_I2C
                bool "Config test i2c"
                default n
                if USER_TEST_I2C
                    if ADD_XIZI_FETURES
                        config I2C_DEV_DRIVER
                            string "Set i2c dev path"
                            default "/dev/i2c_dev"
                    endif
                endif

            config USER_TEST_SEMC
                bool "Config test semc sdram"
                default n

            config USER_TEST_LCD
                bool "Config test lcd device"
                default n

                
        endif
endmenu
```

## APP_Framework/Applications/knowing_app/Kconfig
```kconfig
menu "knowing app"
     menuconfig APPLICATION_KNOWING
        bool "Using knowing apps"
        default n
        
    if APPLICATION_KNOWING
        source "$APP_DIR/Applications/knowing_app/mnist/Kconfig" 
        source "$APP_DIR/Applications/knowing_app/face_detect/Kconfig" 
        source "$APP_DIR/Applications/knowing_app/instrusion_detect/Kconfig" 
        source "$APP_DIR/Applications/knowing_app/helmet_detect/Kconfig" 
        source "$APP_DIR/Applications/knowing_app/iris_ml_demo/Kconfig" 
        source "$APP_DIR/Applications/knowing_app/k210_fft_test/Kconfig" 
        source "$APP_DIR/Applications/knowing_app/image_processing/Kconfig" 
        source "$APP_DIR/Applications/knowing_app/cmsis_5_demo/Kconfig" 
 
    endif 
endmenu
```

## APP_Framework/Applications/knowing_app/face_detect/Kconfig
```kconfig
config FACE_DETECT
    bool "enable apps/face detect"
    depends on BOARD_K210_EVB
	depends on DRV_USING_OV2640
	depends on USING_KPU_PROCESSING
	depends on USING_YOLOV2
	depends on USING_YOLOV2_JSONPARSER
    select LIB_USING_CJSON
    default n
```

## APP_Framework/Applications/knowing_app/image_processing/TJpgDec_APP/Kconfig
```kconfig
config IMAGE_PROCESSING_TJPGDEC_APP
    bool "image processing apps/TJpgDec(example)"
    select IMAGE_PROCESSING_USING_TJPGD
    default n
```

## APP_Framework/Applications/knowing_app/instrusion_detect/Kconfig
```kconfig
config INSTRUSION_DETECT
    bool "enable apps/instrusion detect"
    depends on BOARD_K210_EVB
	depends on DRV_USING_OV2640
	depends on USING_KPU_PROCESSING
	depends on USING_YOLOV2
    select LIB_USING_CJSON
    default n
```

## APP_Framework/Applications/knowing_app/k210_detect_entry/Kconfig
```kconfig
config K210_DETECT_ENTRY
    bool "enable apps/k210 yolov2 detect entry"
    depends on BOARD_K210_EVB
	depends on DRV_USING_OV2640
	depends on USING_KPU_PROCESSING
	depends on USING_YOLOV2
	depends on USING_YOLOV2_JSONPARSER
	depends on USING_K210_YOLOV2_DETECT
    select LIB_USING_CJSON
    default n

config K210_DETECT_CONFIGJSON
	string "k210 detect config path"
	default "/kmodel/face.json"
	---help---
		k210 detect task config json path
```

## APP_Framework/Applications/mongoose/Kconfig
```kconfig
menuconfig USE_MONGOOSE
    bool "Use mongoose as webserver"
    default n
    select BSP_USING_SDIO
    select BSP_USING_W5500
    select BSP_USING_ETHERNET
    select SUPPORT_CONNECTION_FRAMEWORK
    select CONNECTION_ADAPTER_4G
    select ADAPTER_EC200A
    select LIB_USING_LORAWAN
    select LIB_USING_LORA_RADIO
```

## APP_Framework/Applications/ota/Kconfig
```kconfig
menu "config application bin ota "
    menuconfig APPLICATION_OTA
        bool "Using app bin ota"
        default n


endmenu
```

## APP_Framework/Framework/connection/4G/Kconfig
```kconfig
config ADAPTER_4G
        bool "Using 4G adapter function"
        default y

        if ADAPTER_4G
            config ADAPTER_EC200T
                    bool "Using 4G adapter device EC200T"
                    default y
            
            if ADAPTER_EC200T
                source "$APP_DIR/Framework/connection/4G/EC200T/Kconfig"
            endif
                
        endif
```

## APP_Framework/Framework/connection/4g/Kconfig
```kconfig
config ADAPTER_EC200T
        bool "Using 4G adapter device EC200T"
        default n

if ADAPTER_EC200T
    source "$APP_DIR/Framework/connection/4g/ec200t/Kconfig"
endif

config ADAPTER_EC200A
        bool "Using 4G adapter device EC200A"
        default n

if ADAPTER_EC200A
    source "$APP_DIR/Framework/connection/4g/ec200a/Kconfig"
endif
                
```

## APP_Framework/Framework/connection/4g/ec200a/Kconfig
```kconfig
config ADAPTER_4G_EC200A
        string "EC200A adapter name"
        default "ec200a"

if ADD_XIZI_FEATURES
        config ADAPTER_EC200A_DRIVER
                string "EC200A device uart driver path"
                default "/dev/usart6_dev6"
endif
```

## APP_Framework/Framework/connection/4g/ec200t/Kconfig
```kconfig
config ADAPTER_4G_EC200T
        string "EC200T adapter name"
        default "ec200t"

if ADD_XIUOS_FETURES
        config ADAPTER_EC200T_PWRKEY
                int "EC200T PWRKEY pin number"
                default "97"

        config ADAPTER_EC200T_PIN_DRIVER
                string "EC200T device pin driver path"
                default "/dev/pin_dev"

        config ADAPTER_EC200T_DRIVER_EXTUART
                bool "Using extra uart to support 4G"
                default n

        config ADAPTER_EC200T_DRIVER
                string "EC200T device uart driver path"
                default "/dev/usart2_dev2"
                depends on !ADAPTER_EC200T_DRIVER_EXTUART

        if ADAPTER_EC200T_DRIVER_EXTUART                    
                config ADAPTER_EC200T_DRIVER
                        string "EC200T device extra uart driver path"
                        default "/dev/extuart_dev5"

                config ADAPTER_EC200T_DRIVER_EXT_PORT
                        int "if EC200T device using extuart, choose port"
                        default "5"
        endif
endif

if ADD_NUTTX_FETURES

endif

if ADD_RTTHREAD_FETURES

endif
```

## APP_Framework/Framework/connection/Kconfig
```kconfig
menuconfig SUPPORT_CONNECTION_FRAMEWORK
        bool "support connection framework"
        default n

if SUPPORT_CONNECTION_FRAMEWORK
        config CONNECTION_FRAMEWORK_DEBUG
        bool "Using connection framework debug log function"
        default y

        menuconfig CONNECTION_ADAPTER_LORA
                bool "Using lora adapter device"
                default n
        if CONNECTION_ADAPTER_LORA
        source "$APP_DIR/Framework/connection/lora/Kconfig"
        endif

        menuconfig CONNECTION_ADAPTER_4G
                bool "Using 4G adapter device"
                default n
        if CONNECTION_ADAPTER_4G
        source "$APP_DIR/Framework/connection/4G/Kconfig"
        endif

        menuconfig CONNECTION_ADAPTER_NB
                bool "Using nbiot adapter device"
                default n
        if CONNECTION_ADAPTER_NB
        source "$APP_DIR/Framework/connection/nbiot/Kconfig"
        endif

        menuconfig CONNECTION_ADAPTER_WIFI
                bool "Using wifi adapter device"
                default n
        if CONNECTION_ADAPTER_WIFI
        source "$APP_DIR/Framework/connection/wifi/Kconfig"
        endif

        menuconfig CONNECTION_ADAPTER_ETHERNET
                bool "Using ethernet adapter device"
                default n
        if CONNECTION_ADAPTER_ETHERNET
        source "$APP_DIR/Framework/connection/ethernet/Kconfig"
        endif

        menuconfig CONNECTION_ADAPTER_BLUETOOTH
                bool "Using bluetooth adapter device"
                default n
        if CONNECTION_ADAPTER_BLUETOOTH
        source "$APP_DIR/Framework/connection/bluetooth/Kconfig"
        endif

        menuconfig CONNECTION_ADAPTER_ZIGBEE
                bool "Using zigbee adapter device"
                default n
        if CONNECTION_ADAPTER_ZIGBEE
        source "$APP_DIR/Framework/connection/zigbee/Kconfig"
        endif

        menuconfig CONNECTION_ADAPTER_5G
                bool "Using 5G adapter device"
                default n
        if CONNECTION_ADAPTER_5G
        source "$APP_DIR/Framework/connection/5G/Kconfig"
        endif
endif
```

## APP_Framework/Framework/connection/bluetooth/Kconfig
```kconfig
config ADAPTER_HC08
        bool "Using bluetooth adapter device HC08"
        default y

if ADAPTER_HC08
    source "$APP_DIR/Framework/connection/bluetooth/HC08/Kconfig"
endif      
```

## APP_Framework/Framework/connection/lora/Kconfig
```kconfig
config ADAPTER_SX1278
        bool "Using lora adapter device SX1278"
        default y

choice 
        prompt "Lora device adapter select net role type "
        default AS_LORA_CLIENT_ROLE

        config AS_LORA_GATEWAY_ROLE
                bool "config as a gateway"

        config AS_LORA_CLIENT_ROLE
                bool "config as a client"
endchoice

if AS_LORA_GATEWAY_ROLE
        config ADAPTER_LORA_NET_ROLE_ID
        hex "if Lora device config as a gateway, set gateway net id"
        default "0x10"
endif

if AS_LORA_CLIENT_ROLE
        config ADAPTER_LORA_NET_ROLE_ID
        hex "if Lora device config as a client, set client net id"
        default "0x01"
endif

if ADAPTER_SX1278
    source "$APP_DIR/Framework/connection/lora/sx1278/Kconfig"
endif 
```

## APP_Framework/Framework/connection/nbiot/Kconfig
```kconfig
if CONNECTION_ADAPTER_NB
    config ADAPTER_BC28
            bool "Using nbiot adapter device BC28"
            default y
    
    if ADAPTER_BC28
        source "$APP_DIR/Framework/connection/nbiot/BC28/Kconfig"
    endif
        
endif
```

## APP_Framework/Framework/connection/wifi/Kconfig
```kconfig
config ADAPTER_HFA21_WIFI
        help
            Please check HFA21 can only work for adapter_wifi or adapter_ethernet in the meantime!
        bool "Using wifi adapter device HFA21"
        default n

if ADAPTER_HFA21_WIFI
    source "$APP_DIR/Framework/connection/wifi/hfa21_wifi/Kconfig"
endif
```

## APP_Framework/Framework/connection/zigbee/e18/Kconfig
```kconfig
config ADAPTER_ZIGBEE_E18
        string "E18 adapter name"
        default "e18"
        
choice 
        prompt "E18 adapter select net role type "
        default AS_END_DEVICE_ROLE

        config AS_COORDINATOR_ROLE
                bool "config as a coordinator"

        config AS_ROUTER_ROLE
                bool "config as a router"
        
        config AS_END_DEVICE_ROLE
                bool "config as an end device"
endchoice


if ADD_XIUOS_FETURES

        config ADAPTER_E18_DRIVER_EXTUART
                bool "Using extra uart to support zigbee"
                default n

        config ADAPTER_E18_DRIVER
                string "E18 device uart driver path"
                default "/dev/uart2_dev2"
                depends on !ADAPTER_E18_DRIVER_EXTUART

        if ADAPTER_E18_DRIVER_EXTUART                    
                config ADAPTER_E18_DRIVER
                        string "E18 device extra uart driver path"
                        default "/dev/extuart_dev0"

                config ADAPTER_E18_DRIVER_EXT_PORT
                        int "if E18 device using extuart, choose port"
                        default "0"
        endif
endif

if ADD_NUTTX_FETURES

endif

if ADD_RTTHREAD_FETURES

endif
```

## APP_Framework/Framework/control/Kconfig
```kconfig
menuconfig SUPPORT_CONTROL_FRAMEWORK
    bool "support control framework"
    default n
    select TRANSFORM_LAYER_ATTRIUBUTE
    select BSP_USING_SDIO
    select MOUNT_SDCARD_FS
    select LIB_USING_CJSON

if SUPPORT_CONTROL_FRAMEWORK
    config BSP_USING_SERIAL_485
        bool
        default n

    config CONTROL_RECIPE_FILE
        string "control framework recipe file name"
        default "test_recipe.json"

    menuconfig CONTROL_IPC_PROTOCOL
        bool "Using ipc protocol"
        default n
    if CONTROL_IPC_PROTOCOL
        source "$APP_DIR/Framework/control/ipc_protocol/Kconfig"
    endif

    menuconfig CONTROL_PLC_PROTOCOL
        bool "Using plc protocol"
        default n
    if CONTROL_PLC_PROTOCOL
        source "$APP_DIR/Framework/control/plc_protocol/Kconfig"
    endif
    
endif
```

## APP_Framework/Framework/control/ipc_protocol/Kconfig
```kconfig
config CONTROL_PROTOCOL_MODBUS_TCP
        bool "Using modbus_tcp control protocol"
        default n

config CONTROL_PROTOCOL_MODBUS_UART
        bool "Using modbus_uart control protocol"
        default n
```

## APP_Framework/Framework/control/plc/interoperability/Kconfig
```kconfig
menuconfig USING_CONTROL_PLC_OPCUA
        bool "PLC support OPCUA"
        default y
		depends on RESOURCES_LWIP
```

## APP_Framework/Framework/control/plc_protocol/Kconfig
```kconfig
config CONTROL_PROTOCOL_FINS
        bool "Using fins control protocol"
        default n

config CONTROL_PROTOCOL_MELSEC
        bool "Using melsec control protocol"
        default n

config CONTROL_PROTOCOL_OPCUA
        bool "Using opcua control protocol"
        default n

config CONTROL_PROTOCOL_S7
        bool "Using s7 control protocol"
        default n
```

## APP_Framework/Framework/control/plc_protocol/melsec/Kconfig
```kconfig
choice
    prompt "select melsec protocol"
    default CONTROL_PROTOCOL_MELSEC_1E

    config CONTROL_PROTOCOL_MELSEC_1E
        bool "support melsec_1e protocol, using TCP"
    
    config CONTROL_PROTOCOL_MELSEC_3E_Q_L
        bool "support melsec_3e_q_l protocol, using TCP"

    config CONTROL_PROTOCOL_MELSEC_3E_IQ_R
        bool "support melsec_3e_iq_r protocol, using TCP"

    config CONTROL_PROTOCOL_MELSEC_1C
        bool "support melsec_1c protocol, using SERIAL"

    config CONTROL_PROTOCOL_MELSEC_3C
        bool "support melsec_3c protocol, using SERIAL"
endchoice
```

## APP_Framework/Framework/knowing/Kconfig
```kconfig
menuconfig SUPPORT_KNOWING_FRAMEWORK
        bool "support knowing framework"
        default y

if SUPPORT_KNOWING_FRAMEWORK
        source "$APP_DIR/Framework/knowing/tensorflow-lite/Kconfig"
        source "$APP_DIR/Framework/knowing/filter/Kconfig"
        source "$APP_DIR/Framework/knowing/ota/Kconfig"
        source "$APP_DIR/Framework/knowing/image_processing/Kconfig"
        source "$APP_DIR/Framework/knowing/cmsis_5/Kconfig"
        source "$APP_DIR/Framework/knowing/kpu/Kconfig"
endif
```
