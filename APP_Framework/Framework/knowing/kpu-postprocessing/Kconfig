## APP_Framework/Framework/knowing/kpu-postprocessing/Kconfig
```kconfig
menuconfig USING_KPU_POSTPROCESSING
    bool "kpu model postprocessing"
    default y
if USING_KPU_POSTPROCESSING
        source "$APP_DIR/Framework/knowing/kpu-postprocessing/yolov2/Kconfig"
endif
```

## APP_Framework/Framework/knowing/kpu/k210_detect_procedure/Kconfig
```kconfig
menuconfig USING_K210_DETECT
    bool "k210 yolov2 detect procedure"
	depends on USING_KPU_PROCESSING
    default n
```

## APP_Framework/Framework/sensor/ch4/Kconfig
```kconfig
config SENSOR_AS830
        bool "Using as830"
        default n

        if SENSOR_AS830
                config SENSOR_DEVICE_AS830
                        string "as830 sensor name"
                        default "as830_1"
                
                config SENSOR_QUANTITY_AS830_CH4
                        string "as830 quantity name"
                        default "ch4_1"
                
                if ADD_XIUOS_FETURES
                        config SENSOR_AS830_DRIVER_EXTUART
                                bool "Using extra uart to support as830"
                                default y

                        config SENSOR_DEVICE_AS830_DEV
                                string "as830 device uart path"
                                default "/dev/uart2_dev2"
                                depends on !SENSOR_AS830_DRIVER_EXTUART

                        if SENSOR_AS830_DRIVER_EXTUART
                                config SENSOR_DEVICE_AS830_DEV
                                        string "as830 device extra uart path"
                                        default "/dev/extuart_dev4"

                                config SENSOR_DEVICE_AS830_DEV_EXT_PORT
                                        int "if AS830 device using extuart, choose port"
                                        default "4"
                        endif
                endif

                if ADD_NUTTX_FETURES

                endif

                if ADD_RTTHREAD_FETURES

                endif                
        endif
```

## APP_Framework/Framework/sensor/co2/Kconfig
```kconfig
config SENSOR_ZG09
        bool "Using zg09"
        default n

        if SENSOR_ZG09
                config SENSOR_DEVICE_ZG09
                        string "zg09 sensor name"
                        default "zg09_1"
                
                config SENSOR_QUANTITY_ZG09_CO2
                        string "zg09 quantity name"
                        default "co2_1"
                
                if ADD_XIUOS_FETURES
                        config SENSOR_ZG09_DRIVER_EXTUART
                                bool "Using extra uart to support zg09"
                                default y

                        config SENSOR_DEVICE_ZG09_DEV
                                string "zg09 device uart path"
                                default "/dev/uart2_dev2"
                                depends on !SENSOR_ZG09_DRIVER_EXTUART

                        if SENSOR_ZG09_DRIVER_EXTUART
                                config SENSOR_DEVICE_ZG09_DEV
                                        string "zg09 device extra uart path"
                                        default "/dev/extuart_dev4"

                                config SENSOR_DEVICE_ZG09_DEV_EXT_PORT
                                        int "if ZG09 device using extuart, choose port"
                                        default "4"
                        endif
                endif

                if ADD_NUTTX_FETURES
                       config SENSOR_DEVICE_ZG09_DEV
                               string "CO2 device name"
                               default "/dev/ttyS1"
                               ---help---
                                   If USART1 is selected, then fill in /dev/ttyS1 here.

                endif

                if ADD_RTTHREAD_FETURES

                endif                
        endif
```

## APP_Framework/Framework/sensor/humidity/Kconfig
```kconfig
config SENSOR_HS300X
        bool "Using HS300x"
        default n

        if SENSOR_HS300X
                config SENSOR_DEVICE_HS300X
                        string "HS300x sensor name"
                        default "hs300x_1"
                
                config SENSOR_QUANTITY_HS300X_HUMIDITY
                        string "HS300x quantity name"
                        default "humidity_1"
                
                if ADD_XIUOS_FETURES                
                        config SENSOR_DEVICE_HS300X_DEV
                                string "HS300x device name"
                                default "/dev/i2c1_dev0"
                endif

                if ADD_NUTTX_FETURES

                endif

                if ADD_RTTHREAD_FETURES

                endif
        endif
```

## APP_Framework/Framework/sensor/iaq/Kconfig
```kconfig
config SENSOR_TB600B_IAQ10
        bool "Using TB600B IAQ10"
        default n

        if SENSOR_TB600B_IAQ10
                config SENSOR_DEVICE_TB600B_IAQ10
                        string "tb600b iaq10 sensor name"
                        default "tb600b_iaq10_1"
                
                config SENSOR_QUANTITY_TB600B_IAQ
                        string "tb600b iaq10 quantity name"
                        default "iaq_1"
                
                if ADD_XIUOS_FETURES
                        config SENSOR_TB600B_IAQ10_DRIVER_EXTUART
                                bool "Using extra uart to support tb600b iaq10"
                                default y

                        config SENSOR_DEVICE_TB600B_IAQ10_DEV
                                string "tb600b iaq10 device uart path"
                                default "/dev/uart2_dev2"
                                depends on !SENSOR_TB600B_IAQ10_DRIVER_EXTUART

                        if SENSOR_TB600B_IAQ10_DRIVER_EXTUART
                                config SENSOR_DEVICE_TB600B_IAQ10_DEV
                                        string "tb600b iaq10 device extra uart path"
                                        default "/dev/extuart_dev5"

                                config SENSOR_DEVICE_TB600B_IAQ10_DEV_EXT_PORT
                                        int "if TB600B_IAQ10 device using extuart, choose port"
                                        default "5"
                        endif
                endif

                if ADD_NUTTX_FETURES

                endif

                if ADD_RTTHREAD_FETURES

                endif                
        endif
```

## APP_Framework/Framework/sensor/voice/Kconfig
```kconfig
config SENSOR_D124
        bool "Using D124"
        default n

        if SENSOR_D124
                config SENSOR_DEVICE_D124
                        string "D124 sensor name"
                        default "d124_1"
                
                config SENSOR_QUANTITY_D124_VOICE
                        string "D124 quantity PM1.0 name"
                        default "voice_1"
                
                if ADD_XIUOS_FETURES
                        config SENSOR_D124_DRIVER_EXTUART
                                bool "Using extra uart to support D124"
                                default y

                        config SENSOR_DEVICE_D124_DEV
                                string "D124 device name"
                                default "/dev/uart2_dev2"
                                depends on !SENSOR_D124_DRIVER_EXTUART

                        if SENSOR_D124_DRIVER_EXTUART
                                config SENSOR_DEVICE_D124_DEV
                                        string "D124 device extra uart path"
                                        default "/dev/extuart_dev4"
                                
                                config SENSOR_DEVICE_D124_DEV_EXT_PORT
                                        int "if D124 device using extuart, choose port"
                                        default "4"
                        endif
                endif

                if ADD_NUTTX_FETURES

                endif

                if ADD_RTTHREAD_FETURES

                endif
        endif
```

## APP_Framework/lib/JerryScript/Kconfig
```kconfig
menu "lib using JerryScript"
    menuconfig PKG_USING_JERRYSCRIPT
        bool "JerryScript: Ultra-lightweight JavaScript engine for the Internet of Things."
        default n
endmenu
```

## APP_Framework/lib/freemodbus/Kconfig
```kconfig
menu "lib using freemodbus"
    menuconfig LIB_USING_FREEMODBUS
        bool "USING freemodbus"
        default n
endmenu
```

## APP_Framework/lib/lorawan/Kconfig
```kconfig
menu "lib using LoRaWan"

menuconfig LIB_USING_LORAWAN
    bool "Using LoRaWan lib"
    default n

    if LIB_USING_LORAWAN
        menuconfig LIB_USING_LORAWAN_ED_STACK
            help 
                Please add "source "$APP_DIR/lib/lorawan/lorawan_devicenode/Kconfig"" when using lorawan_devicenode
            bool "LoRaWan using lorawan_ed_stack lib"
            default n
            select LIB_USING_LORA_RADIO

        if LIB_USING_LORAWAN_ED_STACK

        endif

        menuconfig LIB_USING_LORA_RADIO
            help
                Please add "source "$APP_DIR/lib/lorawan/lora_radio_driver/Kconfig"" when using lora_radio_driver
            bool "LoRaWan using lora-radio-driver lib"
            default n

        if LIB_USING_LORA_RADIO

        endif
    endif

endmenu
```

## APP_Framework/lib/mqtt/Kconfig
```kconfig
menu "lib using MQTT"

    menuconfig TOOL_USING_MQTT
        bool "Enable support MQTT function"
        default n
        select SUPPORT_CONNECTION_FRAMEWORK
        select CONNECTION_ADAPTER_4G
        
    if TOOL_USING_MQTT
        menu "MQTT connection parameter configuration."
            config PLATFORM_PRODUCTKEY
                string "Product Key, used to identify a product."
                default "iv74vebCdJC"

            config CLIENT_DEVICENAME
                string "Device name, used to identify a client device."
                default "D001"

            config CLIENT_DEVICESECRET
                string "Device secret, used for device authentication and data encryption."
                default "d2e613c4f714b6b0774bd7b68eeceae3"
        
            config PLATFORM_SERVERIP
                string "mqtt platform server ip."
                default "101.133.196.127"

            config PLATFORM_SERVERPORT
                string "mqtt platform server port."
                default "1883"
        endmenu
    endif

endmenu
```

## Ubiquitous/Nuttx/aiit_board/imxrt1052-ok/Kconfig
```kconfig
#
# For a description of the syntax of this configuration file,
# see the file kconfig-language.txt in the NuttX tools repository.
#

if ARCH_BOARD_IMXRT1052_OK

choice
	prompt "Boot Flash"
	default IMXRT1052_OK_HYPER_FLASH

config IMXRT1052_OK_HYPER_FLASH
	bool "HYPER Flash"

config IMXRT1052_OK_QSPI_FLASH
	bool "QSPI Flash"

endchoice # Boot Flash

config IMXRT1052_OK_SDRAM
	bool "Enable SDRAM"
	default n
	select IMXRT_SEMC_INIT_DONE
	---help---
		Activate DCD configuration of SDRAM

endif
```

## Ubiquitous/Nuttx/aiit_board/xidatong/Kconfig
```kconfig
#
# For a description of the syntax of this configuration file,
# see the file kconfig-language.txt in the NuttX tools repository.
#

if ARCH_BOARD_XIDATONG

choice
	prompt "Boot Flash"
	default XIDATONG_HYPER_FLASH

config XIDATONG_HYPER_FLASH
	bool "HYPER Flash"

config XIDATONG_QSPI_FLASH
	bool "QSPI Flash"

endchoice # Boot Flash

config XIDATONG_SDRAM
	bool "Enable SDRAM"
	default n
	select IMXRT_SEMC_INIT_DONE
	---help---
		Activate DCD configuration of SDRAM

endif
```

## Ubiquitous/Nuttx_Fusion_XiUOS/aiit_board/edu-riscv64/Kconfig
```kconfig
#
# For a description of the syntax of this configuration file,
# see misc/tools/kconfig-language.txt.
#

if ARCH_BOARD_EDU_RISCV64

menuconfig BSP_USING_CH376
    bool "Using CH376 device"
    default n
    select K210_UART
    select K210_UART3
    
if BSP_USING_CH376

choice
	prompt "select ch376 function."
	default CH376_USB_FUNCTION

config CH376_USB_FUNCTION
	bool "select ch376 usb function"

config CH376_SD_FUNCTION
	bool "select ch376 sd function"
endchoice

config CH376_WORK_MODE
	hex "ch376 work mode set:0x03 sd,0x06 u-disk"
	default 0x03 if CH376_SD_FUNCTION
	default 0x06 if CH376_USB_FUNCTION

endif # BSP_USING_CH376

menuconfig BSP_USING_ENET
    bool "Using ENET device"
    default n

endif # ARCH_BOARD_EDU_RISCV64
```

## Ubiquitous/Nuttx_Fusion_XiUOS/aiit_board/xidatong/Kconfig
```kconfig
#
# For a description of the syntax of this configuration file,
# see the file kconfig-language.txt in the NuttX tools repository.
#

if ARCH_BOARD_XIDATONG

choice
	prompt "Boot Flash"
	default XIDATONG_QSPI_FLASH

config XIDATONG_HYPER_FLASH
	bool "HYPER Flash"

config XIDATONG_QSPI_FLASH
	bool "QSPI Flash"

endchoice # Boot Flash

config XIDATONG_SDRAM
	bool "Enable SDRAM"
	default y
	select IMXRT_SEMC_INIT_DONE
	---help---
		Activate DCD configuration of SDRAM

config XIDATONG_SDIO_AUTOMOUNT
  bool "SD card automounter"
  default n
  depends on FS_AUTOMOUNTER && IMXRT_USDHC

if XIDATONG_SDIO_AUTOMOUNT

config XIDATONG_SDIO_AUTOMOUNT_FSTYPE
  string "SD card file system type"
  default "vfat"

config XIDATONG_SDIO_AUTOMOUNT_BLKDEV
  string "SD card block device"
  default "/dev/mmcsd0"

config XIDATONG_SDIO_AUTOMOUNT_MOUNTPOINT
  string "SD card mount point"
  default "/mnt/sdcard"

config XIDATONG_SDIO_AUTOMOUNT_DDELAY
  int "SD card debounce delay (milliseconds)"
  default 1000

config XIDATONG_SDIO_AUTOMOUNT_UDELAY
  int "SD card unmount retry delay (milliseconds)"
  default 2000

endif # XIDATONG_SDIO_AUTOMOUNT

config XIDATONG_USB_AUTOMOUNT
	bool "USB Mass Storage automounter"
	default n
	depends on USBHOST_MSC && USBHOST_MSC_NOTIFIER

if XIDATONG_USB_AUTOMOUNT

config XIDATONG_USB_AUTOMOUNT_FSTYPE
	string "USB file system type"
	default "vfat"

config XIDATONG_USB_AUTOMOUNT_BLKDEV
	string "USB block device prefix"
	default "/dev/sd"

config XIDATONG_USB_AUTOMOUNT_MOUNTPOINT
	string "USB mount point prefix"
	default "/mnt/usb"

config XIDATONG_USB_AUTOMOUNT_NUM_BLKDEV
	int "Number of block devices to monitor."
	range 1 26
	default 4

config XIDATONG_USB_AUTOMOUNT_UDELAY
	int "USB unmount retry delay (milliseconds)"
	default 2000

endif # XIDATONG_USB_AUTOMOUNT

menuconfig BSP_USING_CH438
    bool "Using CH438 device"
    default n

if BSP_USING_CH438
config CH438_EXTUART0
	bool "using ch438 port 0"
	default n

config CH438_EXTUART1
	bool "using ch438 port 1"
	default n

config CH438_EXTUART2
	bool "using ch438 port 2"
	default n

config CH438_EXTUART3
	bool "using ch438 port 3"
	default n

config CH438_EXTUART4
	bool "using ch438 port 4"
	default n

config CH438_EXTUART5
	bool "using ch438 port 5"
	default n

config CH438_EXTUART6
	bool "using ch438 port 6"
	default n

config CH438_EXTUART7
	bool "using ch438 port 7"
	default n

endif # BSP_USING_CH438

endif # ARCH_BOARD_XIDATONG
```

## Ubiquitous/XiUOS/board/aiit-arm32-board/third_party_driver/lcd/Kconfig
```kconfig
if BSP_USING_LCD
    config LCD_BUS_NAME
        string "lcd bus name"
        default "lcd"
    config LCD_DRV_NAME
        string "lcd bus driver name"
        default "lcd_drv"
    config LCD_DEVICE_NAME
        string "lcd bus device name"
        default "lcd_dev"   
endif
```
