## Ubiquitous/XiUOS/board/ok1052-c/third_party_driver/Kconfig
```kconfig
menuconfig BSP_USING_LPUART
    bool "Using UART device"
    default y
    select RESOURCES_SERIAL
    if BSP_USING_LPUART
        source "$BSP_DIR/third_party_driver/uart/Kconfig"
    endif

menuconfig BSP_USING_LWIP
    bool "Using LwIP device"
    default n
    select RESOURCES_LWIP

menuconfig BSP_USING_SEMC
    bool "Using SEMC device"
    default n
    if BSP_USING_SEMC
        source "$BSP_DIR/third_party_driver/semc/Kconfig"
    endif

menuconfig BSP_USING_SDIO
    bool "Using SD card device"
    default n
    select RESOURCES_SDIO
    if BSP_USING_SDIO
        source "$BSP_DIR/third_party_driver/sdio/Kconfig"
    endif
```

## Ubiquitous/XiZi/board/aiit-riscv64-board/third_party_driver/ch438/Kconfig
```kconfig
if BSP_USING_CH438
    config CH438_BUS_NAME
        string
        default "extuart"

    config CH438_DRIVER_NAME
        string
        default "extuart_drv"

    config CH438_DEVICE_NAME_0
        string
        default "extuart_dev0"

    config CH438_DEVICE_NAME_1
        string
        default "extuart_dev1"

    config CH438_DEVICE_NAME_2
        string
        default "extuart_dev2"

    config CH438_DEVICE_NAME_3
        string
        default "extuart_dev3"

    config CH438_DEVICE_NAME_4
        string
        default "extuart_dev4"

    config CH438_DEVICE_NAME_5
        string
        default "extuart_dev5"

    config CH438_DEVICE_NAME_6
        string
        default "extuart_dev6"

    config CH438_DEVICE_NAME_7
        string
        default "extuart_dev7"

    config BSP_CH438_ALE_PIN
        int "ALE pin number for ch438"
        default 23

    config BSP_CH438_NWR_PIN
        int "NWR pin number for ch438"
        default 24

    config BSP_CH438_NRD_PIN
        int "NRD pin number for ch438"
        default 25
        
    config BSP_CH438_D0_PIN
        int "D0 pin number for ch438"
        default 27
        
    config BSP_CH438_D1_PIN
        int "D1 pin number for ch438"
        default 28
        
    config BSP_CH438_D2_PIN
        int "D2 pin number for ch438"
        default 29
        
    config BSP_CH438_D3_PIN
        int "D3 pin number for ch438"
        default 30
        
    config BSP_CH438_D4_PIN
        int "D4 pin number for ch438"
        default 31
        
    config BSP_CH438_D5_PIN
        int "D5 pin number for ch438"
        default 32
        
    config BSP_CH438_D6_PIN
        int "D6 pin number for ch438"
        default 33
        
    config BSP_CH438_D7_PIN
        int "D7 pin number for ch438"
        default 34
        
    config BSP_CH438_INT_PIN
        int "INT pin number for ch438"
        default 35
        
    config BSP_485_dir
        int "485 direction pin number for ch438"
        default 18
        
endif
```

## Ubiquitous/XiZi/board/xidatong-riscv64/third_party_driver/spi/Kconfig
```kconfig
config BSP_USING_SPI1
bool "Using spi1  "
default y


if BSP_USING_SPI1
    config SPI_BUS_NAME_1
        string "spi bus 1 name"
        default "spi1"
    config SPI_1_DRV_NAME
        string "spi bus 1 driver name"
        default "spi1_drv"
    config BSP_SPI1_CLK_PIN
        int "spi1 clk pin number"
        default 9
    config BSP_SPI1_D0_PIN
        int "spi1 MOSI d0 pin number"
        default 11
    config BSP_SPI1_D1_PIN
        int "spi1 MISO d1 pin number"
        default 10
    menuconfig BSP_SPI1_USING_SS0
        bool "SPI1 Enable SS0"
        default y
    if BSP_SPI1_USING_SS0
        config SPI_1_DEVICE_NAME_0
            string "spi bus 1 device 0 name"
            default "spi1_dev0"
        config BSP_SPI1_SS0_PIN
            int "spi1 ss0 pin number"
            default 12
    endif
endif
```

## Ubiquitous/XiZi_IIoT/board/at32f437vmt7/third_party_driver/uart/Kconfig
```kconfig
menuconfig BSP_USING_UART1
    bool "Enable USART1 for Console"
    default y
    if BSP_USING_UART1
        config SERIAL_BUS_NAME_1
            string "serial bus 1 name"
            default "usart1"
        config SERIAL_DRV_NAME_1
            string "serial bus 1 driver name"
            default "usart1_drv"
        config SERIAL_1_DEVICE_NAME_0
            string "serial bus 1 device 0 name"
            default "usart1_dev1"
    endif

menuconfig BSP_USING_UART2
    bool "Enable USART2 for RS485/RS322"
    default y
    if BSP_USING_UART2
        config SERIAL_BUS_NAME_2
            string "serial bus 2 name"
            default "usart2"
        config SERIAL_DRV_NAME_2
            string "serial bus 2 driver name"
            default "usart2_drv"
        config SERIAL_2_DEVICE_NAME_0
            string "serial bus 2 device 0 name"
            default "usart2_dev2"
    endif

menuconfig BSP_USING_CONSOLE
    bool "Enable Console"
    default y
    select BSP_USING_UART1
    if BSP_USING_CONSOLE
        config CONSOLE_BUS_NAME
            string "Console bus name"
            default "usart1"
        config CONSOLE_DRV_NAME
            string "Console bus driver name"
            default "usart1_drv"
        config CONSOLE_DEVICE_NAME_0
            string "Console bus device 0 name"
            default "usart1_dev1"
    endif

config BSP_USING_RS485
    bool "Enable RS485"
    default y
    select BSP_USING_UART2

config BSP_USING_RS232
    bool "Enable RS232"
    default y
    select BSP_USING_UART2
```

## Ubiquitous/XiZi_IIoT/board/ch569w/third_party_driver/Kconfig
```kconfig
menuconfig BSP_USING_UART
    bool "Using UART device"
    default y
    select RESOURCES_SERIAL
    if BSP_USING_UART
        source "$BSP_DIR/third_party_driver/uart/Kconfig"
    endif

menuconfig BSP_USING_SPI
    bool "Using SPI device"
    default y
    if BSP_USING_SPI
        source "$BSP_DIR/third_party_driver/spi/Kconfig"
    endif

menuconfig BSP_USING_WDT
    bool "Using watchdog timer device"
    default y
```

## Ubiquitous/XiZi_IIoT/board/hc32f4a0/third_party_driver/timer/Kconfig
```kconfig
menuconfig BSP_USING_TIMER_0
bool "Using timer 0"
default n
select RESOURCES_HWTIMER

if BSP_USING_TIMER_0
    config HWTIMER_BUS_NAME_0
        string "timer 0 bus 0 name"
        default "timer0"
    config HWTIMER_0_DEVICE_NAME_0
        string "timer 0 bus 0 device 0 name"
        default "timer0_dev0" 
    config HWTIMER_DRIVER_NAME_0
        string "timer 0 bus 0 driver name"
        default "timer0_drv"
endif
```

## Ubiquitous/XiZi_IIoT/board/hc32f4a0/third_party_driver/usb/Kconfig
```kconfig
config BSP_USING_HC32_USBH
    bool "Using usb host by HC32 library"
    default y
    if BSP_USING_HC32_USBH
        config USB_BUS_NAME
            string "usb bus name"
            default "usb"
        config USB_DRIVER_NAME
            string "usb bus driver name"
            default "usb_drv"
        config USB_DEVICE_NAME
            string "usb bus device name"
            default "usb_dev"
    endif
```

## Ubiquitous/XiZi_IIoT/board/stm32l476rgt6/third_party_driver/Kconfig
```kconfig
menuconfig BSP_USING_UART
bool "Using UART device"
default y
select RESOURCES_SERIAL
if BSP_USING_UART
source "$BSP_DIR/third_party_driver/uart/Kconfig"
endif


menuconfig BSP_USING_SPI
bool "Using SPI device"
default y
select RESOURCES_SPI
if BSP_USING_SPI
source "$BSP_DIR/third_party_driver/spi/Kconfig"
endif

menuconfig BSP_USING_USB
bool "Using USB device"
default y
select RESOURCES_USB
if BSP_USING_USB
source "$BSP_DIR/third_party_driver/usb/Kconfig"
endif
```

## Ubiquitous/XiZi_IIoT/board/stm32l476rgt6/third_party_driver/usb/Kconfig
```kconfig
config BSP_USING_USB
    bool "Using usb device by HAL library"
    default y
    if BSP_USING_USB
        config USB_BUS_NAME
            string "usb bus name"
            default "usb"
        config USB_DRIVER_NAME
            string "usb bus driver name"
            default "usb_drv"
        config USB_DEVICE_NAME
            string "usb bus device name"
            default "usb_dev"
    endif
```
