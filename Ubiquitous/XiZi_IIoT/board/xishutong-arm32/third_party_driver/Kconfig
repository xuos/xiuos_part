## Ubiquitous/XiZi_IIoT/board/xishutong-arm32/third_party_driver/Kconfig
```kconfig
menuconfig BSP_USING_UART
    bool "Using UART device"
    default y
    select RESOURCES_SERIAL
    if BSP_USING_UART
        source "$BSP_DIR/third_party_driver/usart/Kconfig"
    endif

menuconfig BSP_USING_GPIO
    bool "Using GPIO device "
    default y
    select RESOURCES_PIN
    if BSP_USING_GPIO
        source "$BSP_DIR/third_party_driver/gpio/Kconfig"
    endif

menuconfig BSP_USING_LWIP
    bool "Using LwIP by ethernet device"
    default n
    select RESOURCES_LWIP
    if BSP_USING_LWIP
        source "$BSP_DIR/third_party_driver/ethernet/Kconfig"
    endif

menuconfig BSP_USING_SDIO
    bool "Using SD CARD device"
    default n
    select RESOURCES_SDIO
    if BSP_USING_SDIO
        source "$BSP_DIR/third_party_driver/sdio/Kconfig"
    endif
```

## Ubiquitous/XiZi_IIoT/board/xishutong-arm32/third_party_driver/ethernet_wiz/Kconfig
```kconfig
# Kconfig file

config BSP_WIZ_RST_PIN
    int 
    default 13

config BSP_WIZ_INT_PIN
    int 
    default 14
```

## Ubiquitous/XiZi_IIoT/tool/Kconfig
```kconfig
menu "Tool feature"

    source "$KERNEL_DIR/tool/bootloader/Kconfig"
    source "$KERNEL_DIR/tool/libcanard/Kconfig"

endmenu
```

## Ubiquitous/XiZi_IIoT/tool/bootloader/Kconfig
```kconfig
menu "OTA function"

    menuconfig TOOL_USING_OTA
        bool "Enable support OTA function"
        default n
        
    if TOOL_USING_OTA
        choice 
            prompt "Compile bootloader bin or application bin."
            default MCUBOOT_BOOTLOADER

            config MCUBOOT_BOOTLOADER
                    bool "Config as bootloader."

            config MCUBOOT_APPLICATION
                    bool "Config as application."
        endchoice

        if MCUBOOT_APPLICATION
            choice 
                prompt "The way of OTA firmware upgrade."
                default OTA_BY_PLATFORM

                config OTA_BY_PLATFORM
                    bool "Through IoT management platform."
                    select TOOL_USING_MQTT

                config OTA_BY_TCPSERVER
                    bool "Through the public network TCP server."
                    select SUPPORT_CONNECTION_FRAMEWORK
                    select CONNECTION_ADAPTER_4G
            endchoice
        endif


        menu "Flash area address and size configuration."
            config CHIP_FLAH_BASE
                hex "Flash base address of the chip."
                default 0x60000000

            config XIUOS_FLAH_ADDRESS
                hex "Flash area address of the XiUOS system."
                default 0x60100000

            config BAKUP_FLAH_ADDRESS
                hex "Flash area address of the backup firmware."
                default 0x60300000

            config DOWN_FLAH_ADDRESS
                hex "Flash area address of the downloaded firmware."
                default 0x60500000

            config FLAG_FLAH_ADDRESS
                hex "Flash area address of the OTA information."
                default 0x60700000

            config APP_FLASH_SIZE
                hex "Application package size,the default size is limited to 1M."
                default 0x00100000
        endmenu

        config OTA_RX_TIMEOUT
            int "OTA receive data timeout(ms)."
            default 600 if OTA_BY_PLATFORM
            default 10000 if OTA_BY_TCPSERVER
            default 10000 if MCUBOOT_BOOTLOADER
        
        config OTA_RX_BUFFERSIZE
            int "OTA receive data buffer size."
            default 3072 if OTA_BY_PLATFORM
            default 2048 if OTA_BY_TCPSERVER
            default 256 if MCUBOOT_BOOTLOADER
    endif

endmenu
```

## Ubiquitous/XiZi_IIoT/tool/libcanard/Kconfig
```kconfig
menu "UVCAN"

menuconfig TOOL_USING_UVCAN
    bool "Enable UVCAN function"
    default y

endmenu
```

## Ubiquitous/XiZi_IIoT/tool/mqtt/Kconfig
```kconfig
menu "MQTT function"

    menuconfig TOOL_USING_MQTT
        bool "Enable support MQTT function"
        default n
        select SUPPORT_CONNECTION_FRAMEWORK
        select CONNECTION_ADAPTER_4G
        
    if TOOL_USING_MQTT
        menu "MQTT connection parameter configuration."
            config PLATFORM_PRODUCTKEY
                string "Product Key, used to identify a product."
                default "iywhcgnuezz"

            config CLIENT_DEVICENAME
                string "Device name, used to identify a client device."
                default "D001"

            config CLIENT_DEVICESECRET
                string "Device secret, used for device authentication and data encryption."
                default "43b3c332233e2204a0612bfbfe21bb67"
        
            config PLATFORM_SERVERIP
                string "mqtt platform server ip."
                default "101.133.196.127"

            config PLATFORM_SERVERPORT
                string "mqtt platform server port."
                default "1883"
        endmenu
    endif

endmenu
```
